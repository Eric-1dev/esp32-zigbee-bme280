## sdkconfig.defaults
```kconfig
CONFIG_IDF_TARGET_ESP32H2=y
CONFIG_ZB_ENABLED=y
CONFIG_ZB_RADIO_NATIVE=y
CONFIG_ZB_ZED=y
CONFIG_ZB_USE_DEFAULT_STACK_CONFIG=n
CONFIG_ZB_TRACE_LEVEL=3
CONFIG_BROWNOUT_DET=n
CONFIG_ESP_TASK_WDT_PANIC=n
CONFIG_ESP_TIMER_PROFILING=n
CONFIG_I2C_MASTER_ENABLE=y
CONFIG_I2C_BUS_NUM_AUTO=1
CONFIG_ADC_CALI_SCHEME_CURVE_FITTING_SUPP=y
CONFIG_ADC_CUSTOME_VREF=1100
CONFIG_ADC_ONESHOT_ENABLE=y
CONFIG_ADC_CALIBRATION_ENABLE=y
CONFIG_ADC_CUSTOME_VREF=1100
CONFIG_PARTITION_TABLE_CUSTOM=y
CONFIG_ESP_DEFAULT_CPU_FREQ_MHZ_48=y
```
